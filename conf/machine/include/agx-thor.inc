## conf/machine/include/agx-thor.inc
```bitbake
# Common settings for AGX Thor modules

require conf/machine/include/tegra254.inc

KERNEL_ARGS ?= "mminit_loglevel=4 console=tty0 console=ttyTCU0,115200 firmware_class.path=/etc/firmware fbcon=map:0 nospectre_bhb console=tty0"

EMMC_DEVSECT_SIZE ?= "512"
BOOTPART_SIZE ?= "8388608"
BOOTPART_LIMIT ?= "10485760"
ROOTFSPART_SIZE_DEFAULT ?= "60129542144"
ODMDATA ?= "gbe-uphy-config-22,hsstp-lane-map-3,nvhs-uphy-config-0,hsio-uphy-config-0,gbe0-enable-10g"
EMMC_BCT ?= "tegra254-p3701-0000-sdram-l4t.dts"
PARTITION_LAYOUT_TEMPLATE_DEFAULT ?= "flash_t254_qspi_sdmmc.xml"
TEGRA_AUDIO_DEVICE ?= "tegra-hda-jetson-agx"

OTABOOTDEV ?= "/dev/mtdblock0"
OTAGPTDEV ?= "/dev/mtdblock0"

TEGRA_PLUGIN_MANAGER_OVERLAYS ?= "tegra254-p3737-0000+p3701-0000-dynamic.dtbo tegra254-carveouts.dtbo tegra-optee.dtbo tegra254-p3737-camera-dual-imx274-overlay.dtbo tegra254-p3737-camera-e3331-overlay.dtbo tegra254-p3737-camera-e3333-overlay.dtbo tegra254-p3737-camera-imx185-overlay.dtbo"

TEGRA_FLASHVAR_BPFDTB_FILE ?= "tegra254-bpmp-3701-0000-3737-0000.dtb"
TEGRA_FLASHVAR_BPF_FILE ?= "bpmp_t254-TE990M-A1_prod.bin"
TEGRA_FLASHVAR_BR_CMD_CONFIG ?= "tegra254-mb1-bct-reset-p3701-0000.dts"
TEGRA_FLASHVAR_CHIP_SKU ?= "00:00:00:D0"
TEGRA_FLASHVAR_DEVICEPROD_CONFIG ?= "tegra254-mb1-bct-cprod-p3701-0000.dts"
TEGRA_FLASHVAR_DEVICE_CONFIG ?= "tegra254-mb1-bct-device-p3701-0000.dts"
TEGRA_FLASHVAR_DEV_PARAMS ?= "tegra254-br-bct-p3701-0000.dts"
TEGRA_FLASHVAR_DEV_PARAMS_B ?= "tegra254-br-bct_b-p3701-0000.dts"
TEGRA_FLASHVAR_EMC_FUSE_DEV_PARAMS ?= "tegra254-br-bct-diag-boot.dts"
TEGRA_FLASHVAR_GPIOINT_CONFIG ?= "tegra254-mb1-bct-gpioint-p3701-0000.dts"
TEGRA_FLASHVAR_MB2BCT_CFG ?= "tegra254-mb2-bct-misc-p3701-0000.dts"
TEGRA_FLASHVAR_MINRATCHET_CONFIG ?= "--minratchet_config tegra254-mb1-bct-ratchet-p3701-0000.dts"
TEGRA_FLASHVAR_MISC_CONFIG ?= "tegra254-mb1-bct-misc-p3701-0000.dts"
TEGRA_FLASHVAR_PINMUX_CONFIG ?= "tegra254-mb1-bct-pinmux-p3701-0000-a04.dtsi"
TEGRA_FLASHVAR_PMC_CONFIG ?= "tegra254-mb1-bct-padvoltage-p3701-0000-a04.dtsi"
TEGRA_FLASHVAR_PMIC_CONFIG ?= "tegra254-mb1-bct-pmic-p3701-@PMICBOARDSKU@.dts"
TEGRA_FLASHVAR_PROD_CONFIG ?= "tegra254-mb1-bct-prod-p3701-0000.dts"
TEGRA_FLASHVAR_SCR_CONFIG ?= "tegra254-mb2-bct-scr-p3701-0000.dts"
TEGRA_FLASHVAR_UPHY_CONFIG ?= "--uphy tegra254-mb1-bct-uphylane-si.dtsi"
TEGRA_FLASHVAR_WB0SDRAM_BCT ?= "tegra254-p3701-0000-wb0sdram-l4t.dts"
```

## conf/machine/include/tegra254.inc
```bitbake
# Settings common to all Thor (tegra254) SoCs

SOC_FAMILY = "tegra254"

require conf/machine/include/soc-family.inc
DEFAULTTUNE ?= "armv8a-crc"
require conf/machine/include/arm/arch-armv8-2a.inc

SERIAL_CONSOLES ?= "115200;ttyTCU0"

KERNEL_MODULE_AUTOLOAD ?= "nvmap nvgpu pwm-fan ina3221"

NVIDIA_CHIP = "0x25"

TEGRA_BOARDID ?= "3701"
TEGRA_FAB ?= "TS4"
TEGRA_BOARDSKU ?= "0000"
TEGRA_BOARDREV ?= "C.0"
TEGRA_CHIPREV ?= "0"
TEGRA_CUDA_ARCHITECTURE ?= "90"

require conf/machine/include/tegra-common.inc

L4T_BSP_PREFIX = "Jetson"
L4T_DEB_SOCNAME = "t254"

NVPMODEL ?= "nvpmodel_p3701_0000"
NVPOWER ?= "jetsonpower_t254"
NVFANCONTROL ?= "nvfancontrol_p3701_0000"

PARTITION_LAYOUT_EXTERNAL_DEFAULT ?= "flash_l4t_t254_nvme.xml"

TEGRA_BOOT_FIRMWARE_FILES = "\
    adsp-fw.bin \
    applet_t254.bin \
    camera-rtcpu-t254-rce.img \
    mb1_t254_prod.bin \
    mb2_t254.bin \
    mb2rf_t254.bin \
    preboot_c10_prod_cr.bin \
    mce_c10_prod_cr.bin \
    mts_c10_prod_cr.bin \
    spe_t254.bin \
    psc_bl1_t254_prod.bin \
    pscfw_t254_prod.bin \
    mce_flash_o10_cr_prod.bin \
    sc7_t254_prod.bin \
    display-t254-dce.bin \
    psc_rf_t254_prod.bin \
    nvdec_t254_prod.fw \
    xusb_t254_prod.bin \
    tegrabl_carveout_id.h \
    pinctrl-tegra.h \
    tegra254-gpio.h \
    readinfo_t254_min_prod.xml \
    fsi-lk.bin \
    nvpva_020.fw \
    tsec_t254.bin \
"
```

## conf/machine/include/tegra264.inc
```bitbake
# Settings for Jetson AGX Thor (tegra264) SoCs
# Thor uses tegra264 chip but shares packages with tegra234 (Orin) from NVIDIA deb feed

SOC_FAMILY = "tegra264"

require conf/machine/include/soc-family.inc
DEFAULTTUNE ?= "armv8a-crc-crypto"
require conf/machine/include/arm/arch-armv8a.inc

SERIAL_CONSOLES ?= "115200;ttyTCU0"

KERNEL_MODULE_AUTOLOAD ?= "nvmap nvgpu pwm-fan ina3221"

# Thor uses chip ID 0x26 (38 decimal) = Tegra264
NVIDIA_CHIP = "0x26"

TEGRA_BOARDID ?= "3834"
TEGRA_FAB ?= "400"
TEGRA_BOARDSKU ?= "0008"
TEGRA_BOARDREV ?= "G.5"
TEGRA_CHIPREV ?= "1"

# Thor compute capability
TEGRA_CUDA_ARCHITECTURE ?= "100"

require conf/machine/include/tegra-common.inc

L4T_BSP_PREFIX = "Jetson"
# Thor reuses Orin (t234) packages from NVIDIA deb repository
# No separate t264 distribution exists - hardware interfaces are compatible
L4T_DEB_SOCNAME = "t234"

NVPMODEL ?= "nvpmodel_p3834_0008"
NVPOWER ?= "jetsonpower_t264"
NVFANCONTROL ?= "nvfancontrol_p3834_0008_p4071_0000"

# Thor uses t264 partition layouts
PARTITION_LAYOUT_EXTERNAL_DEFAULT ?= "flash_l4t_t264_qspi.xml"

# Thor-specific boot firmware files
TEGRA_BOOT_FIRMWARE_FILES = "\
    adsp-fw.bin \
    applet_t264.bin \
    camera-rtcpu-t264-rce.img \
    mb1_t264_prod.bin \
    mb2_t264.bin \
    mb2rf_t264.bin \
    preboot_c10_prod_cr.bin \
    mce_c10_prod_cr.bin \
    mts_c10_prod_cr.bin \
    spe_t264.bin \
    psc_bl1_t264_prod.bin \
    pscfw_t264_prod.bin \
    mce_flash_o10_cr_prod.bin \
    sc7_t264_prod.bin \
    display-t264-dce.bin \
    psc_rf_t264_prod.bin \
    nvdec_t264_prod.fw \
    xusb_t264_prod.bin \
    tegrabl_carveout_id.h \
    pinctrl-tegra.h \
    tegra264-gpio.h \
    readinfo_t264_min_prod.xml \
    fsi-lk.bin \
    nvpva_020.fw \
    tsec_t264.bin \
"
```

## conf/machine/jetson-agx-thor-devkit.conf
```bitbake
#@TYPE: Machine
#@NAME: Nvidia Jetson AGX Thor Developer Kit
#@DESCRIPTION: Machine configuration for Nvidia Jetson AGX Thor Developer Kit

# Include tegra264 base configuration
# Thor uses tegra264 chip (0x26) but shares packages with Orin (t234) from NVIDIA deb feed
require conf/machine/include/tegra264.inc

# Thor uses pre-compiled device tree from NVIDIA BSP (thor-devicetree recipe)
# KERNEL_DEVICETREE ?= "nvidia/tegra234-p3767-0000-p3768-0000-a0.dtb"
KERNEL_ARGS ?= "fw_devlink=off"

MACHINE_FEATURES += "ext4 serial usbhost pci wifi bluetooth alsa"
MACHINE_EXTRA_RRECOMMENDS += "kernel-modules"

# Thor board configuration (P3834 module)
TEGRA_BOARDID = "3834"
TEGRA_FAB = "400"
TEGRA_BOARDSKU = "0008"
TEGRA_BOARDREV = "G.5"
TEGRA_CHIPREV = "1"

# Thor uses Tegra264 chip (0x26)
TEGRA_CHIP = "0x26"
NVIDIA_CHIP = "0x26"

# Storage configuration
EMMC_SIZE = "64"
EMMC_BDEV = "mmcblk0"
BOOTPART_SIZE = "0"
BOOTPART_LIMIT = "0"
ROOTFSPART_SIZE = "30064771072"

# Thor-specific settings for SBSA architecture
TEGRA_SBSA = "1"

# CUDA settings for Thor (compute capability 10.0)
CUDA_ARCHITECTURES = "100"
CUDA_NVCC_ARCH_FLAGS = "--gpu-architecture=compute_100 --gpu-code=sm_100"

# Preferred providers and versions
PREFERRED_PROVIDER_virtual/kernel = "linux-tegra"
PREFERRED_PROVIDER_u-boot = "u-boot-tegra"
PREFERRED_PROVIDER_virtual/bootloader = "u-boot-tegra"

# Prefer R38.4.0 recipes over R36.x recipes
PREFERRED_VERSION_tegra-storage-layout-base = "38.4.0"
PREFERRED_VERSION_tegra-firmware = "38.4.0"
PREFERRED_VERSION_linux-tegra = "6.8.12"

TEGRA_AUDIO_DEVICE = "tegrahda"

# Jetson Linux 38.4.0 settings (includes kernel 6.8.12)
L4T_BSP_NAME = "t264"
L4T_BSP_PREFIX = "Jetson"
L4T_SRCS_NAME = "source"
L4T_VERSION = "38.4.0"

# Kernel version for Thor - R38.4.0 includes 6.8.12
KERNEL_VERSION = "6.8.12"
LINUX_VERSION = "6.8.12"

# Serial console
SERIAL_CONSOLES = "115200;ttyUTC0"

# Boot and partition configuration
TNSPEC_BOOTDEV = "mmcblk0p1"
OTABOOTDEV = "/dev/mmcblk0boot0"
OTAGPTDEV = "/dev/mmcblk0boot1"

# Partition layout files for Thor (t264)
PARTITION_LAYOUT_EXTERNAL ??= "flash_l4t_t264_qspi.xml"
PARTITION_LAYOUT_EXTERNAL_DEFAULT ??= "flash_l4t_t264_qspi.xml"

# Partition layout
TEGRAFLASH_NO_INTERNAL_STORAGE = "0"
TEGRAFLASH_SDCARD_SIZE = ""

# Partition configuration
TEGRA_ROOTFS_FSTYPE = "ext4"
TEGRA_BOOTPART_FSTYPE = "vfat"

# Set variables needed by R36.x recipes during parsing to avoid errors
# These will be overridden by R38.4.0 recipes when actually building
PARTITION_LAYOUT_TEMPLATE_DEFAULT ??= "flash_l4t_t264_qspi.xml"
PARTITION_LAYOUT_TEMPLATE_DEFAULT_SUPPORTS_REDUNDANT ??= "1"

# Additional machine-specific settings
MACHINE_HWCODECS = "gstreamer1.0-omx-tegra"
MACHINE_ESSENTIAL_EXTRA_RDEPENDS += "tegra-firmware thor-devicetree kernel-image"

# Blacklist R36.x recipes for Thor builds
SKIP_RECIPE[tegra-firmware-36.4.4] = "Incompatible with L4T 38.4.0"
SKIP_RECIPE[tegra-storage-layout-base-36.4.4] = "Incompatible with L4T 38.4.0"
SKIP_RECIPE[tegra-storage-layout-36.4.4] = "Incompatible with L4T 38.4.0"
SKIP_RECIPE[tegra-binaries-36.4.4] = "Incompatible with L4T 38.4.0"
SKIP_RECIPE[tegra-flashtools-native-36.4.4] = "Incompatible with L4T 38.4.0"
SKIP_RECIPE[tegra-libraries-core-36.4.4] = "Incompatible with L4T 38.4.0"

# Explicitly prefer R38.4.0 versions
PREFERRED_VERSION_tegra-binaries = "38.4.0"

# GLib 2.80 required for NVIDIA GStreamer plugins (built against Ubuntu 24.04)
# Ubuntu 24.04 / JetPack 7 ships GLib 2.80, Yocto Scarthgap has 2.78
PREFERRED_VERSION_glib-2.0 = "2.80.5"
PREFERRED_VERSION_glib-2.0-native = "2.80.5"

# Allow patch fuzz for GLib 2.80 (patches from 2.78 apply with minor fuzz)
ERROR_QA:remove:pn-glib-2.0 = "patch-fuzz"
ERROR_QA:remove:pn-glib-2.0-native = "patch-fuzz"
WARN_QA:append:pn-glib-2.0 = " patch-fuzz"
WARN_QA:append:pn-glib-2.0-native = " patch-fuzz"

# GStreamer 1.24 required for NVIDIA GStreamer plugins (built against Ubuntu 24.04)
PREFERRED_VERSION_gstreamer1.0 = "1.24.12"
PREFERRED_VERSION_gstreamer1.0-native = "1.24.12"
PREFERRED_VERSION_gstreamer1.0-plugins-base = "1.24.12"
PREFERRED_VERSION_gstreamer1.0-plugins-good = "1.24.12"
PREFERRED_VERSION_gstreamer1.0-plugins-bad = "1.24.12"
PREFERRED_VERSION_gstreamer1.0-libav = "1.24.12"
```
